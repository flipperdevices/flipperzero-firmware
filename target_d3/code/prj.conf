## CMakeLists.txt
```
cmake_minimum_required(VERSION 3.13.1)

find_package(Zephyr REQUIRED HINTS ../zephyr)

project(flipper-zero-firmware)

target_include_directories(app PRIVATE ${ZEPHYR_BASE}/include/cmsis_rtos_v2)

include_directories(include ../../core ../../applications)

add_definitions(-DEXAMPLE_BLINK -DEXAMPLE_IPC)

target_sources(app PRIVATE src/main.c)
target_sources(app PRIVATE src/flipper_hal.c)

target_sources(app PRIVATE ../../core/app.cpp)
target_sources(app PRIVATE ../../core/log.c)
target_sources(app PRIVATE ../../core/tty_uart.c)
target_sources(app PRIVATE ../../core/furi.c)
target_sources(app PRIVATE ../../core/furi_ac.c)

target_sources(app PRIVATE ../../applications/examples/blink.c)
target_sources(app PRIVATE ../../applications/examples/uart_write.c)
target_sources(app PRIVATE ../../applications/examples/ipc.c)

target_sources(app PRIVATE ../../applications/tests/furiac_test.c)
target_sources(app PRIVATE ../../applications/tests/furi_record_test.c)
target_sources(app PRIVATE ../../applications/tests/test_index.c)
```

## prj.conf
```kconfig
CONFIG_ASSERT=y
CONFIG_ASSERT_LEVEL=2

CONFIG_CMSIS_RTOS_V2=y
CONFIG_NUM_PREEMPT_PRIORITIES=56

CONFIG_THREAD_NAME=y
CONFIG_THREAD_STACK_INFO=y
CONFIG_THREAD_MONITOR=y
CONFIG_THREAD_CUSTOM_DATA=y

CONFIG_INIT_STACKS=y
CONFIG_POLL=y

CONFIG_PRINTK=y
CONFIG_GPIO=y

CONFIG_MAIN_STACK_SIZE=2048
CONFIG_HEAP_MEM_POOL_SIZE=2048

CONFIG_LOG=y
CONFIG_LOG_BUFFER_SIZE=4096

CONFIG_DISK_ACCESS=y
CONFIG_FILE_SYSTEM=y
CONFIG_FAT_FILESYSTEM_ELM=y

CONFIG_BT_DEBUG_LOG=y
CONFIG_BT_LOG_LEVEL_INF=y
CONFIG_USB_DEVICE_LOG_LEVEL_INF=y

CONFIG_BT=y
CONFIG_BT_PERIPHERAL=y
CONFIG_BT_DEVICE_NAME="Flipper Zero"
CONFIG_BT_GATT_CLIENT=y

CONFIG_USB=y
CONFIG_USB_COMPOSITE_DEVICE=y
CONFIG_USB_DEVICE_STACK=y
CONFIG_USB_DEVICE_PRODUCT="Flipper Zero"

CONFIG_ENTROPY_GENERATOR=y
CONFIG_ENTROPY_DEVICE_RANDOM_GENERATOR=y

CONFIG_USB_DEVICE_HID=y
CONFIG_USB_HID_DEVICE_COUNT=2

CONFIG_USB_CDC_ACM=y
CONFIG_USB_CDC_ACM_DEVICE_COUNT=2

CONFIG_SERIAL=y
CONFIG_UART_INTERRUPT_DRIVEN=y
CONFIG_UART_LINE_CTRL=y
```

## src/main.c
```c
#include <stdint.h>
#include <string.h>

#include <zephyr.h>
#include <device.h>
#include <drivers/gpio.h>
#include <sys/printk.h>
#include <cmsis_os2.h>

#include "main.h"

SerialDevice DEBUG_UART = NULL;

void app_serial_write(SerialDevice* serial, uint8_t* buffer, uint16_t size, uint32_t timeout) {
    printk((const char*)buffer);
}

bool task_equal(osThreadId_t a, osThreadId_t b) {
    if(a == NULL || b == NULL) return false;

    return a == b;
}

void app();

void main() {
    app();

    while(1);
}
```

## include/flipper_hal.h
```c
/*
Flipper devices inc.

GPIO and HAL implementations
*/

#pragma once

#include <stdint.h>
#include <stdbool.h>

#include <device.h>
#include <devicetree.h>
#include <drivers/gpio.h>

typedef enum {
    GpioModeInput = GPIO_INPUT,
    GpioModeOutput = GPIO_OUTPUT,
    GpioModeOpenDrain = GPIO_OUTPUT
} GpioMode;

typedef struct {
    char* label;
    gpio_pin_t pin;
} GpioPin;

#define LED0_NODE DT_ALIAS(led0)
#if DT_NODE_HAS_STATUS(LED0_NODE, okay)
  #define LED0_LABEL DT_GPIO_LABEL(LED0_NODE, gpios)
  #define LED0_PIN DT_GPIO_PIN(LED0_NODE, gpios)
#else
  #error "Unsupported board: led0 devicetree alias is not defined"
  #define LED0_LABEL ""
  #define LED0_PIN 0
#endif

#define LED_RED {.label = LED0_LABEL, .pin = LED0_PIN} 

void app_gpio_init(GpioPin gpio, GpioMode mode);

void app_gpio_write(GpioPin gpio, bool state);

bool app_gpio_read(GpioPin gpio);

void app_delay_us(uint32_t time);
void app_delay(uint32_t time);

void pwm_set(float value, float freq, TIM_HandleTypeDef* tim, uint32_t channel);

void app_tim_ic_init(bool both);

void app_tim_pulse(uint32_t width);

void app_tim_stop();
```

## include/main.h
```c
#pragma once

#include <device.h>

typedef struct device* SerialDevice;
void app_serial_write(SerialDevice* serial, uint8_t* buffer, uint16_t size, uint32_t timeout);
```

## src/flipper_hal.c
```c
/*
Flipper devices inc.

GPIO and HAL implementations
*/

#include "main.h"
#include "flipper_hal.h"
#include <stdio.h>
#include <zephyr.h>

void app_gpio_init(GpioPin gpio, GpioMode mode) {
    struct device *port;
    port = device_get_binding(gpio.label);
    gpio_pin_configure(port, gpio.pin, mode);
}

void app_gpio_write(GpioPin gpio, bool state) {
    struct device *port;
    port = device_get_binding(gpio.label);
    gpio_pin_set(port, gpio.pin, state);
}

bool app_gpio_read(GpioPin gpio) {
    struct device *port;
    port = device_get_binding(gpio.label);
    return gpio_pin_get(port, gpio.pin);
}

void app_delay_us(uint32_t time) {
    printf("[DELAY] %d us\n", time);
}

void app_delay(uint32_t time) {
    k_msleep(time);
}

void pwm_set(float value, float freq, TIM_HandleTypeDef* tim, uint32_t channel) {
    printf("[TIM] set pwm: %d %f Hz, %f%%\n", channel, freq, value * 100.);
}


void app_tim_ic_init(bool both) {
    printf("[TIM] init\n");
}

void app_tim_pulse(uint32_t width) {
    printf("[TIM] pulse %d\n", width);
}

void app_tim_stop() {
    printf("[TIM] stop\n");
}
```
