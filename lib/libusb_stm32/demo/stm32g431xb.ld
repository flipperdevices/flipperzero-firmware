ENTRY(Reset_Handler)
MEMORY
{
    ROM   (rx): ORIGIN = 0x08000000, LENGTH = 128K
    RAM  (rwx): ORIGIN = 0x20000000, LENGTH = 22K
    SRAM (rwx): ORIGIN = 0x10000000, LENGTH = 10K
}

INCLUDE sections.ld
