ENTRY(Reset_Handler)
MEMORY
{
	ROM    (rx): ORIGIN = 0x08000000, LENGTH = 1024K
	RAM   (rwx): ORIGIN = 0x20000000, LENGTH = 128K
	RAM2  (rwx): ORIGIN = 0x10000000, LENGTH = 64K
}

INCLUDE sections.ld
