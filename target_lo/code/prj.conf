## CMakeLists.txt
```
cmake_minimum_required(VERSION 3.13.1)

option(TEST "build tests" OFF)

find_package(Zephyr REQUIRED HINTS ../zephyr)

project(flipper-zero-firmware)

target_include_directories(app PRIVATE ${ZEPHYR_BASE}/include/cmsis_rtos_v2)

include_directories(include ../../core ../../applications)

find_library(FLIPPER_CORE_LIBRARY flipper_core HINTS ../../core-rs/target/x86_64-unknown-linux-gnu PATH_SUFFIXES debug release)

target_link_libraries(app PRIVATE ${FLIPPER_CORE_LIBRARY})

if(TEST)
    add_definitions(-DTEST)
else()
    add_definitions(-DEXAMPLE_BLINK -DEXAMPLE_IPC)
endif(TEST)

target_sources(app PRIVATE src/main.c)
target_sources(app PRIVATE src/flipper_hal.c)

target_sources(app PRIVATE ../../core/app.cpp)
target_sources(app PRIVATE ../../core/log.c)
target_sources(app PRIVATE ../../core/tty_uart.c)
target_sources(app PRIVATE ../../core/furi.c)
target_sources(app PRIVATE ../../core/furi_ac.c)

target_sources(app PRIVATE ../../applications/examples/blink.c)
target_sources(app PRIVATE ../../applications/examples/uart_write.c)
target_sources(app PRIVATE ../../applications/examples/ipc.c)

target_sources(app PRIVATE ../../applications/tests/furiac_test.c)
target_sources(app PRIVATE ../../applications/tests/furi_record_test.c)
target_sources(app PRIVATE ../../applications/tests/test_index.c)
```

## west.yml
```
manifest:
  defaults:
    remote: zephyrproject-rtos

  remotes:
    - name: zephyrproject-rtos
      url-base: https://github.com/zephyrproject-rtos

  projects:
    - name: zephyr
      remote: zephyrproject-rtos
      revision: v2.3.0
      import: true

  self:
    path: code
```

## prj.conf
```kconfig
CONFIG_ASSERT=y
CONFIG_ASSERT_LEVEL=2

CONFIG_CMSIS_RTOS_V2=y
CONFIG_NUM_PREEMPT_PRIORITIES=56
CONFIG_SYS_CLOCK_TICKS_PER_SEC=10000

CONFIG_THREAD_NAME=y
CONFIG_THREAD_STACK_INFO=y
CONFIG_THREAD_MONITOR=y
CONFIG_THREAD_CUSTOM_DATA=y

CONFIG_INIT_STACKS=y
CONFIG_POLL=y

CONFIG_PRINTK=y

CONFIG_MAIN_STACK_SIZE=2048
CONFIG_HEAP_MEM_POOL_SIZE=2048

CONFIG_LOG=y
```

## src/main.c
```c
#include <stdint.h>
#include <string.h>
#include <pthread.h>

#include <zephyr.h>
#include <device.h>
#include <drivers/gpio.h>
#include <sys/printk.h>
#include <cmsis_os2.h>

#include "main.h"

SerialDevice DEBUG_UART = NULL;

void app_serial_write(SerialDevice* serial, uint8_t* buffer, uint16_t size, uint32_t timeout) {
    write(1, (const char*)buffer, size);
}

bool task_equal(osThreadId_t a, osThreadId_t b) {
    if(a == NULL || b == NULL) return false;

    return a == b;
}

void app();

void main() {
    app();

    while(1);
}
```

## include/flipper_hal.h
```c
/*
Flipper devices inc.

GPIO and HAL implementations
*/

#pragma once

#include <stdio.h>
#include <stdbool.h>
#include "main.h"

typedef enum {
    GpioModeInput,
    GpioModeOutput,
    GpioModeOpenDrain
} GpioMode;

typedef struct {
    const char* port;
    uint32_t pin;
    GpioMode mode;
} GpioPin;

#define LED_RED {.pin = GPIO_PIN_8, .port = GPIOA}

void app_gpio_init(GpioPin gpio, GpioMode mode);

void app_gpio_write(GpioPin gpio, bool state);

bool app_gpio_read(GpioPin gpio);

void app_delay_us(uint32_t time);
void app_delay(uint32_t time);

typedef enum {
    GPIO_PIN_SET = 1,
    GPIO_PIN_RESET = 0
} HAL_GPIO_PIN_STATE;

// TODO rewrite to zephyr
void HAL_GPIO_WritePin(const char* port, uint32_t pin, HAL_GPIO_PIN_STATE state);

void pwm_set(float value, float freq, TIM_HandleTypeDef* tim, uint32_t channel);

void app_tim_ic_init(bool both);

void app_tim_pulse(uint32_t width);

void app_tim_stop();

#define GPIOA "PA"
#define GPIOB "PB"
#define GPIOC "PC"
#define GPIOD "PD"
#define GPIOE "PE"

#define GPIO_PIN_0 0
#define GPIO_PIN_1 1
#define GPIO_PIN_2 2
#define GPIO_PIN_3 3
#define GPIO_PIN_4 4
#define GPIO_PIN_5 5
#define GPIO_PIN_6 6
#define GPIO_PIN_7 7
#define GPIO_PIN_8 8
#define GPIO_PIN_9 9
#define GPIO_PIN_10 10
#define GPIO_PIN_11 11
#define GPIO_PIN_12 12
#define GPIO_PIN_13 13
#define GPIO_PIN_14 14
#define GPIO_PIN_15 15

#define DISPLAY_RST_GPIO_Port "DISPLAY RST"
#define DISPLAY_DI_Pin 0

#define DISPLAY_DI_GPIO_Port "DISPLAY DI"
#define DISPLAY_RST_Pin 0

#define DISPLAY_CS_GPIO_Port "DISPLAY CS"
#define DISPLAY_CS_Pin 0

#define DISPLAY_BACKLIGHT_GPIO_Port "BACKLIGHT"
#define DISPLAY_BACKLIGHT_Pin 0

typedef const char* SPI_HandleTypeDef;

typedef uint32_t HAL_StatusTypeDef;

HAL_StatusTypeDef HAL_SPI_Transmit(SPI_HandleTypeDef *hspi, uint8_t *pData, uint16_t Size, uint32_t Timeout);
```

## include/main.h
```c
#include <stdint.h>
#include <stdlib.h>
#include <limits.h>

#define HAL_MAX_DELAY INT_MAX

typedef struct device* SerialDevice;
void app_serial_write(SerialDevice* serial, uint8_t* buffer, uint16_t size, uint32_t timeout);

typedef uint32_t TIM_HandleTypeDef;
```

## src/flipper_hal.c
```c
/*
Flipper devices inc.

GPIO and HAL implementations
*/

#include "main.h"
#include "flipper_hal.h"
#include <stdio.h>
#include <zephyr.h>

void app_gpio_init(GpioPin gpio, GpioMode mode) {
    if(gpio.pin != 0) {

        switch(mode) {
            case GpioModeInput:
                printf("[GPIO] %s%d input\n", gpio.port, gpio.pin);
            break;

            case GpioModeOutput:
                printf("[GPIO] %s%d push pull\n", gpio.port, gpio.pin);
            break;

            case GpioModeOpenDrain:
                printf("[GPIO] %s%d open drain\n", gpio.port, gpio.pin);
            break;
        }

        gpio.mode = mode;
    } else {
        printf("[GPIO] no pin\n");
    }
}

void app_gpio_write(GpioPin gpio, bool state) {
    if(gpio.pin != 0) {
        if(state) {
            printf("[GPIO] %s%d on\n", gpio.port, gpio.pin);
        } else {
            printf("[GPIO] %s%d off\n", gpio.port, gpio.pin);
        }
    } else {
        printf("[GPIO] no pin\n");
    }
}

bool app_gpio_read(GpioPin gpio) {
    // TODO emulate pin state?

    return false;
}

void app_delay_us(uint32_t time) {
    // How to deal with it
    printf("[DELAY] %d us\n", time);
}

void app_delay(uint32_t time) {
    k_msleep(time);
}

void pwm_set(float value, float freq, TIM_HandleTypeDef* tim, uint32_t channel) {
    printf("[TIM] set pwm %d:%d %f Hz, %f%%\n", *tim, channel, freq, value * 100.);
}

void app_tim_ic_init(bool both) {
    printf("[TIM] init\n");
}

void app_tim_pulse(uint32_t width) {
    printf("[TIM] pulse %d\n", width);
}

void app_tim_stop() {
    printf("[TIM] stop\n");
}

void HAL_GPIO_WritePin(const char* port, uint32_t pin, HAL_GPIO_PIN_STATE state) {
    printf("[GPIO] set pin %s:%d = %d\n", port, pin, state);
}

HAL_StatusTypeDef HAL_SPI_Transmit(SPI_HandleTypeDef* hspi, uint8_t *pData, uint16_t size, uint32_t Timeout) {
    printf("[SPI] write %d to %s: ", size, *hspi);
    for(size_t i = 0; i < size; i++) {
        printf("%02X ", pData[i]);
    }
    printf("\n");
    
    return 0;
}

SPI_HandleTypeDef hspi1 = "spi1";
```
