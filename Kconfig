## Kconfig
```kconfig
menu "ESP serial flasher"
    config SERIAL_FLASHER_MD5_ENABLED
        bool "Enable MD5 check"
        default y
        help
            Select this option to enable MD5 hashsum check after flashing.

    config SERIAL_FLASHER_RESET_HOLD_TIME_MS
        int "Time for which the reset pin is asserted when doing a hard reset"
        default 100

    config SERIAL_FLASHER_BOOT_HOLD_TIME_MS
        int "Time for which the boot pin is asserted when doing a hard reset"
        default 50

endmenu
```

## applications/external/esp_flasher/lib/esp-serial-flasher/Kconfig
```kconfig
menu "ESP serial flasher"
    config SERIAL_FLASHER_MD5_ENABLED
        bool "Enable MD5 check"
        default y
        help
            Select this option to enable MD5 hashsum check after flashing.

    choice SERIAL_FLASHER_INTERFACE
        prompt "Hardware interface to use for firmware download"
        default SERIAL_FLASHER_INTERFACE_UART
        help
            esp-serial-flasher can work with UART and SPI interfaces.

        config SERIAL_FLASHER_INTERFACE_UART
            bool "UART"

        config SERIAL_FLASHER_INTERFACE_SPI
            bool "SPI (Only supports downloading to RAM, experimental)"

    endchoice

    config SERIAL_FLASHER_RESET_HOLD_TIME_MS
        int "Time for which the reset pin is asserted when doing a hard reset"
        default 100

    config SERIAL_FLASHER_BOOT_HOLD_TIME_MS
        int "Time for which the boot pin is asserted when doing a hard reset"
        default 50

    config SERIAL_FLASHER_DEBUG_TRACE
        bool "Enable debug tracing output (only transfer data tracing is supported at the time)"
        default n

endmenu
```

## applications/external/totp/lib/wolfssl/IDE/Espressif/ESP-IDF/examples/wolfssl_client/main/Kconfig.projbuild
```kconfig
menu "Example Configuration"

config TARGET_HOST
    string "Target host"
    default "127.0.01.1"
    help
        host address for the example to connect
        
endmenu
```

## applications/external/totp/lib/wolfssl/IDE/Espressif/ESP-IDF/examples/wolfssl_server/sdkconfig.defaults
```kconfig
CONFIG_FREERTOS_HZ=1000
CONFIG_ESP32_DEFAULT_CPU_FREQ_240=y

#
# Default main stack size
#
# This is typically way bigger than needed for stack size. See user_settings.h
#
CONFIG_ESP_MAIN_TASK_STACK_SIZE=55500

# Legacy stack size for older ESP-IDF versions
CONFIG_MAIN_TASK_STACK_SIZE=55500

#
# Compiler options
#
CONFIG_COMPILER_OPTIMIZATION_DEFAULT=y
CONFIG_COMPILER_OPTIMIZATION_ASSERTIONS_ENABLE=y
CONFIG_COMPILER_OPTIMIZATION_ASSERTION_LEVEL=2
CONFIG_COMPILER_HIDE_PATHS_MACROS=y
CONFIG_COMPILER_STACK_CHECK_MODE_NORM=y
CONFIG_COMPILER_STACK_CHECK=y

#
# Partition Table
#
# CONFIG_PARTITION_TABLE_SINGLE_APP is not set
CONFIG_PARTITION_TABLE_SINGLE_APP_LARGE=y
# CONFIG_PARTITION_TABLE_TWO_OTA is not set
# CONFIG_PARTITION_TABLE_CUSTOM is not set
CONFIG_PARTITION_TABLE_CUSTOM_FILENAME="partitions.csv"
CONFIG_PARTITION_TABLE_FILENAME="partitions_singleapp_large.csv"
CONFIG_PARTITION_TABLE_OFFSET=0x8000
CONFIG_PARTITION_TABLE_MD5=y
# end of Partition Table
```

## applications/external/totp/lib/wolfssl/IDE/Espressif/ESP-IDF/examples/wolfssl_test/main/Kconfig.projbuild
```kconfig
menu "Example Configuration"

config BENCH_ARGV
    string "Arguments for benchmark test"
    default "-lng 0"
    help
        -? <num>    Help, print this usage
                     0: English, 1: Japanese
        -csv        Print terminal output in csv format
        -base10     Display bytes as power of 10 (eg 1 kB = 1000 Bytes)
        -no_aad     No additional authentication data passed.
        -dgst_full  Full digest operation performed.
        -rsa_sign   Measure RSA sign/verify instead of encrypt/decrypt.
        -<alg>      Algorithm to benchmark. Available algorithms include:
                    cipher aes-cbc aes-gcm chacha20 chacha20-poly1305
                    digest md5 poly1305 sha sha2 sha224 sha256 sha384 sha512 sha3
                    sha3-224 sha3-256 sha3-384 sha3-512
                    mac hmac hmac-md5 hmac-sha hmac-sha224 hmac-sha256 hmac-sha384
                    hmac-sha512
                    asym rsa rsa-sz dh ecc-kg ecc
                    other rng
        -lng <num>  Display benchmark result by specified language.
                    0: English, 1: Japanese
        <num>       Size of block in bytes

        e.g -lng 1
        e.g sha

endmenu
```

## applications/external/totp/lib/wolfssl/IDE/Espressif/ESP-IDF/examples/wolfssl_test_idf/sdkconfig.defaults
```kconfig
#
# Default main stack size
#
# This is typically way bigger than needed for stack size. See user_settings.h
#
CONFIG_ESP_MAIN_TASK_STACK_SIZE=55000

# Legacy stack size for older ESP-IDF versions
CONFIG_MAIN_TASK_STACK_SIZE=55000

#
# Watchdog Timers
#
# We don't want to have the watchdog timeout during tests
#
CONFIG_ESP_TASK_WDT_CHECK_IDLE_TASK_CPU0=n
CONFIG_ESP_TASK_WDT_CHECK_IDLE_TASK_CPU1=n

#
# Compiler options
#
CONFIG_COMPILER_OPTIMIZATION_DEFAULT=y
CONFIG_COMPILER_OPTIMIZATION_ASSERTIONS_ENABLE=y
CONFIG_COMPILER_OPTIMIZATION_ASSERTION_LEVEL=2
CONFIG_COMPILER_HIDE_PATHS_MACROS=y
CONFIG_COMPILER_STACK_CHECK_MODE_NORM=y
CONFIG_COMPILER_STACK_CHECK=y

# minimum C3 chip revision known to work is 2.
# rev 0 and 1 not available for testing.
# all revisions expected to work.
CONFIG_ESP32C3_REV_MIN_0=
CONFIG_ESP32C3_REV_MIN_1=
CONFIG_ESP32C3_REV_MIN_2=y
CONFIG_ESP32C3_REV_MIN_3=


#
# Partition Table
#
# CONFIG_PARTITION_TABLE_SINGLE_APP is not set
CONFIG_PARTITION_TABLE_SINGLE_APP_LARGE=y
# CONFIG_PARTITION_TABLE_TWO_OTA is not set
# CONFIG_PARTITION_TABLE_CUSTOM is not set
CONFIG_PARTITION_TABLE_CUSTOM_FILENAME="partitions.csv"
CONFIG_PARTITION_TABLE_FILENAME="partitions_singleapp_large.csv"
CONFIG_PARTITION_TABLE_OFFSET=0x8000
CONFIG_PARTITION_TABLE_MD5=y
# end of Partition Table
```

## applications/external/totp/lib/wolfssl/RTOS/nuttx/wolfssl/Kconfig
```kconfig
#
# For a description of the syntax of this configuration file,
# see the file kconfig-language.txt in the NuttX tools repository.
#

menuconfig CRYPTO_WOLFSSL
	bool "wolfSSL SSL/TLS Cryptography Library"
	default n
	---help---
		Enable support for wolfSSL

if CRYPTO_WOLFSSL

config WOLFSSL_VERSION
	string "wolfSSL Version"
	default "5.5.4"

menuconfig WOLFCRYPT_APPS
	tristate "wolfCrypt applications"
	default n
	---help---
		Enable wolfCrypt applications

if WOLFCRYPT_APPS

config WOLFSSL_DEFAULT_TASK_STACKSIZE
	int "wolfSSL app default stack size"
	default 16384

config WOLFCRYPT_APP_BENCHMARK
	bool "wolfCrypt Benchmark application"
	default n
	---help---
		Enable the wolfCrypt benchmark application

if WOLFCRYPT_APP_BENCHMARK

config WOLFCRYPT_APP_BENCHMARK_PROGNAME
	string "Program name"
	default "wolfcrypt_benchmark"
	---help---
		This is the name of the program that will be used when the NSH ELF
		program is installed.

config WOLFCRYPT_APP_BENCHMARK_PRIORITY
	int "wolfcrypt benchmark task priority"
	default 100

config WOLFCRYPT_APP_BENCHMARK_STACKSIZE
	int "wolfcrypt benchmark stack size"
	default WOLFSSL_DEFAULT_TASK_STACKSIZE

endif

config WOLFCRYPT_APP_SELFTEST
	bool "wolfCrypt Self Test application"
	default n
	---help---
		Enable the wolfCrypt self-test app

if WOLFCRYPT_APP_SELFTEST

config WOLFCRYPT_APP_SELFTEST_PROGNAME
	string "Program name"
	default "wolfcrypt_test"
	---help---
		This is the name of the program that will be used when the NSH ELF
		program is installed.

config WOLFCRYPT_APP_SELFTEST_PRIORITY
	int "wolfcrypt self-test task priority"
	default 100

config WOLFCRYPT_APP_SELFTEST_STACKSIZE
	int "wolfcrypt self-test stack size"
	default WOLFSSL_DEFAULT_TASK_STACKSIZE

endif

config WOLFSSL_APP_CLIENT_SERVER
	bool "wolfSSL client and server example"
	default n
	---help---
		runs both a tls client and server in the same task that connect to one
		another, requires local loopback

if WOLFSSL_APP_CLIENT_SERVER

config WOLFSSL_APP_CLIENT_SERVER_PROGNAME
	string "Program name"
	default "wolfssl_client_server"
	---help---
		This is the name of the program that will be used when the NSH ELF
		program is installed.

config WOLFSSL_APP_CLIENT_SERVER_PRIORITY
	int "wolfssl client server task priority"
	default 100

config WOLFSSL_APP_CLIENT_SERVER_STACKSIZE
	int "wolfssl client server stack size"
	default WOLFSSL_DEFAULT_TASK_STACKSIZE

endif

endif

endif # CRYPTO_WOLFSSL
```

## applications/external/totp/lib/wolfssl/zephyr/Kconfig
```kconfig
# Kconfig - Cryptography primitive options for wolfSSL

#
# Copyright (c) 2016 Intel Corporation
#
# Licensed under the Apache License, Version 2.0 (the "License");
# you may not use this file except in compliance with the License.
# You may obtain a copy of the License at
#
#     http://www.apache.org/licenses/LICENSE-2.0
#
# Unless required by applicable law or agreed to in writing, software
# distributed under the License is distributed on an "AS IS" BASIS,
# WITHOUT WARRANTIES OR CONDITIONS OF ANY KIND, either express or implied.
# See the License for the specific language governing permissions and
# limitations under the License.
#

config ZEPHYR_WOLFSSL_MODULE
        bool
config WOLFSSL_PROMPTLESS
        bool
        help
          Symbol to disable the prompt for WOLFSSL selection.
          This symbol may be used internally in a Kconfig tree to hide the
          wolfSSL menu prompt and instead handle the selection of WOLFSSL from
          dependent sub-configurations and thus prevent stuck symbol behavior.


menuconfig WOLFSSL
	bool "wolfSSL Support" if !WOLFSSL_PROMPTLESS
	help
	  This option enables the wolfSSL cryptography library.

if WOLFSSL

choice WOLFSSL_IMPLEMENTATION
	prompt "Select implementation"
	default WOLFSSL_BUILTIN

config WOLFSSL_BUILTIN
	bool "Enable wolfSSL integrated sources"
	help
	  Link with local wolfSSL sources instead of external library.

config WOLFSSL_LIBRARY
	bool "Enable wolfSSL external library"
	help
	  This option enables wolfSSL library.

endchoice

config WOLFSSL_SETTINGS_FILE
	string "wolfSSL settings file"
	depends on WOLFSSL_BUILTIN
	default "user_settings-tls-generic.h"
	help
	  Use a specific wolfSSL settings file. The default config file
	  file can be tweaked with Kconfig. The default settings is
	  suitable to communicate with majority of HTTPS servers on the Internet,
	  but has relatively many features enabled. To optimize resources for
	  special TLS usage, use available Kconfig settings, or select an
	  alternative config.

rsource "Kconfig.tls-generic"

config WOLFSSL_DEBUG
	bool "wolfSSL debug activation"
	depends on WOLFSSL_BUILTIN
	help
	  Enable debugging activation for wolfSSL configuration. If you use
	  wolfSSL/Zephyr integration (e.g. net_app), this will activate debug
	  logging (of the level configured by WOLFSSL_DEBUG_LEVEL).

config WOLFSSL_INSTALL_PATH
	string "wolfSSL install path"
	depends on WOLFSSL_LIBRARY
	help
	  This option holds the path where the wolfSSL libraries and headers are
	  installed. Make sure this option is properly set when WOLFSSL_LIBRARY
	  is enabled otherwise the build will fail.

config APP_LINK_WITH_WOLFSSL
	bool "Link 'app' with WOLFSSL"
	default y
	help
	  Add WOLFSSL header files to the 'app' include path. It may be
	  disabled if the include paths for WOLFSSL are causing aliasing
	  issues for 'app'.

endif
```

## applications/external/totp/lib/wolfssl/zephyr/samples/wolfssl_test/sample.yaml
```yaml
sample:
  description: wolfCrypt test sample app
  name: wolfCrypt test
common:
  harness: console
  harness_config:
    type: one_line
    regex:
      - "Exiting main with return code: 0"
tests:
  sample.crypto.wolfssl_test:
    timeout: 120
    platform_allow: qemu_x86
    integration_platforms:
      - qemu_x86
```

## examples/zephyr_example/sample.yaml
```yaml
sample:
  description: ESP Serial Flasher sample code
  name: zephyr_flasher
tests:
  sample.esp_flasher.zephyr_example:
    platform_allow: esp32
    tags: esp32
```
